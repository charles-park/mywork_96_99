-c8051
-D_R=0
-Z(CODE)INTVEC,RCODE,D_CDATA,I_CDATA,X_CDATA,C_ICALL,C_RECFN,CSTR,CCSTR,CODE,CONST=0

-Z(XDATA)C_ARGX,X_UDATA,X_IDATA,ECSTR,RF_XDATA=0

-Z(DATA)C_ARGD,D_UDATA,D_IDATA,C_ARGI,I_UDATA,I_IDATA,CSTACK=20

-! -Z(IDATA) -!

-Z(BIT)C_ARGB,BITVARS=0
-e_small_write=_formatted_write
-e_medium_read=_formatted_read
cl8051c
jejoo
-o jejoo.hex
-x
-l jejoo.map
-Fintel-standard
