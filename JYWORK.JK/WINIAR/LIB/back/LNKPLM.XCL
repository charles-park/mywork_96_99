-!                 -LNKPLM.XCL-

        XLINK V4.36 and above command file to be used with the 
	8051 C-compiler V4.10 and above together with PLM code.
        using the -mt, -ms, -mc, -mm or -ml memory model
        Usage:  xlink  your_file(s)  -f LNKPLM

        First: define CPU and _R -!

-c8051
-D_R=0

-!  Setup "bit" segments (always zero if there is no need to reserve
    bit variable space for some other purpose) -!

-Z(BIT)PLM_BIT_OV,PLM_BIT,C_ARGB,BITVARS=0


-!  Setup "data" segments.  Start address may not be less
    than _R+8 (start of register bank + 8).  Space must also
    be left for interrupt functions with the "using" attribute. -!

-Z(DATA)PLM_DATA_OV,PLM_DATA,C_ARGD,D_UDATA,D_IDATA=8

-!  Setup "idata" segments (usually loaded after "data") -!

-Z(IDATA)PLM_IDATA_OV,PLM_IDATA,C_ARGI,I_UDATA,I_IDATA,CSTACK

-!  Setup "xdata" segments to the start address of external RAM.
    Note that this declaration does no harm even if you use a memory
    model that does not utilize external data RAM -!

-Z(XDATA)PLM_XDATA,C_ARGX,X_UDATA,X_IDATA,ECSTR,RF_XDATA=0

-!  Setup all read-only segments (PROM). Usually at zero -!

-Z(CODE)INTVEC,RCODE,D_CDATA,I_CDATA,X_CDATA,C_ICALL,C_RECFN=0
-Z(CODE)CSTR,CCSTR,CODE,CONST,PLM_CODE,PLM_CONST

-!  See configuration section concerning printf/sprintf -!
-e_small_write=_formatted_write


-!  See configuration section concerning scanf/sscanf -!
-e_medium_read=_formatted_read


-!  Load the 'C' library adapted for the selected memory model -!
cl8051t  -! or cl8051s, cl8051c, cl8051m, cl8051l -!


-!  Code will now reside on file aout.a03 in INTEL-STANDARD format -!


