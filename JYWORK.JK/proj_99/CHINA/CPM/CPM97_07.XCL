-c8051
-D_R=0
-Z(CODE)INTVEC,RCODE,D_CDATA,I_CDATA,X_CDATA,C_ICALL,C_RECFN,CSTR,CCSTR,CODE,CONST=0

-Z(XDATA)X_IDATA,ECSTR,C_ARGX,X_UDATA,RF_XDATA=0

-Z(DATA)C_ARGD,D_UDATA,D_IDATA=30

-Z(IDATA)C_ARGI,I_UDATA,I_IDATA,CSTACK

-Z(BIT)C_ARGB,BITVARS=0

-! -e_medium_write=_formatted_write -!
-! -e_medium_read=_formatted_read   -!

cl8051l
cpm97_07
-o cpm97_07.hex
-x
-l cpm97_07.map
-Fintel-standard
